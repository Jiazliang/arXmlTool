AUTOSAR XML (schema 4.0)
package /Container2
  Config2 (): ecuc-numerical-param-value=200
