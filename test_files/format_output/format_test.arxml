AUTOSAR XML (schema 4.0)
package /FormatTest
  NoIndent (): parameters=ecuc-integer-param-value=42
