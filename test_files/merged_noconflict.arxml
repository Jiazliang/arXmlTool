AUTOSAR XML (schema 4.0)
package /Container1
  Config1 (): parameters=ecuc-integer-param-value=42
package /Container2
  Config2 (): parameters=ecuc-integer-param-value=100
package /Container3
  Config3 (): parameters=ecuc-integer-param-value=200
