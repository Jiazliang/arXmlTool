AUTOSAR XML (schema 4.0)
package /Container1
  Config1 (): parameters=ecuc-string-param-value=test
