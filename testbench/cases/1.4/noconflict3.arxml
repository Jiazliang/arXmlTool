AUTOSAR XML (schema 4.0)
package /Container3
  Config3 (): parameters=ecuc-integer-param-value=200
