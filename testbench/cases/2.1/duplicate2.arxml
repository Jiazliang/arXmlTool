AUTOSAR XML (schema 4.0)
package /Container1
  Config1 (): ecuc-numerical-param-value=100
