AUTOSAR XML (schema 4.0)
package /Container2
  Config2 (): parameters=ecuc-integer-param-value=100
