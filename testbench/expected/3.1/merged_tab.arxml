AUTOSAR XML (schema 4.0)
package /IndentTest
  TestConfig (): parameters=ecuc-integer-param-value=42
