AUTOSAR XML (schema 4.0)
package /Package_A
  module config Config_A
package /Package_C
  module config Config_B
    3 x :
      Container_A
        3 x :
          SubContainer_A
          SubContainer_B
          SubContainer_C
      Container_B
      Container_C
