AUTOSAR XML (schema 4.0)
package /Package_C
  module config Config_B
    3 x :
      Container_C
      Container_B
      Container_A
        3 x :
          SubContainer_C
          SubContainer_B
          SubContainer_A
package /Package_A
  module config Config_A
